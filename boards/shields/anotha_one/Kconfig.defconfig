## boards/shields/anotha_one/Kconfig.defconfig
```kconfig
# Copyright (c) 2022 The ZMK Contributors
# SPDX-License-Identifier: MIT

if SHIELD_ANOTHA_ONE

config ZMK_KEYBOARD_NAME
    default "Anotha One"

endif
```
